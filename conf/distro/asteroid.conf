## conf/distro/asteroid.conf
```bitbake
# Copyright (C) 2015 Florent Revest <revestflo@gmail.com>
#
# This program is free software; you can redistribute it and/or modify
# it under the terms of the GNU General Public License version 2 as
# published by the Free Software Foundation.
#
# This program is distributed in the hope that it will be useful,
# but WITHOUT ANY WARRANTY; without even the implied warranty of
# MERCHANTABILITY or FITNESS FOR A PARTICULAR PURPOSE.  See the
# GNU General Public License for more details.
#
# You should have received a copy of the GNU General Public License along
# with this program; if not, write to the Free Software Foundation, Inc.,
# 51 Franklin Street, Fifth Floor, Boston, MA 02110-1301 USA.

MAINTAINER = "Florent Revest <revestflo@gmail.com>"

# Distro setup
DISTRO = "asteroid"
DISTRO_NAME = "AsteroidOS"
DISTRO_VERSION ?= "1.1-nightly"

DISTRO_FEATURES = "alsa bluetooth bluez5 opengl pam polkit pulseaudio systemd usbhost usbgadget usrmerge wayland wifi xattr ${DISTRO_FEATURES_LIBC}"

PREFERRED_PROVIDER_jpeg = "libjpeg-turbo"
PREFERRED_PROVIDER_jpeg-native = "libjpeg-turbo-native"

PREFERRED_VERSION_geoclue = "0.12.99"

VIRTUAL-RUNTIME_init_manager = "systemd"
VIRTUAL-RUNTIME_initscripts = ""
PREFERRED_PROVIDER_udev = "systemd"
QT_DIR_NAME = ""

ANDROID_EXTRA_INITRAMFS_IMAGE_INSTALL ?= ""

FILESYSTEM_PERMS_TABLES = "files/fs-perms.txt files/asteroidos-fs-perms.txt"

PACKAGE_FEED_URIS = "https://release.asteroidos.org/nightlies/"
PACKAGE_FEED_BASE_PATHS = "ipk"
PACKAGE_FEED_ARCHS = "all anthias armv7vehf-neon bass beluga catfish core2-32 dory firefish harmony hoki inharmony koi lenok minnow mooneye narwhal nemo pike qemux86 ray skipjack smelt sparrow sprat sturgeon swift tetra triggerfish wren"

SKIP_META_GNOME_SANITY_CHECK = "1"

OLDEST_KERNEL = "3.4"
```

## conf/layer.conf
```bitbake
# We have a conf and classes directory, append to BBPATH
BBPATH .= ":${LAYERDIR}"

# We have a recipes directory, add to BBFILES
BBFILES += "${LAYERDIR}/recipes*/*/*.bb ${LAYERDIR}/recipes*/*/*.bbappend"

BBFILE_COLLECTIONS += "asteroid-layer"
BBFILE_PATTERN_asteroid-layer := "^${LAYERDIR}/"
BBFILE_PRIORITY_asteroid-layer = "7"

LAYERSERIES_COMPAT_asteroid-layer = "kirkstone"

PACKAGE_FEED += "gdb strace"
```

## conf/machine/include/hybris-gki-watch.inc
```bitbake
# Common settings for Halium/GKI-generation hybris watches: devices with a
# Generic Kernel Image era kernel (5.x+) whose Android vendor stack runs in
# an LXC container (Halium style) instead of meta-android's flat android-init
# chroot. Builds on top of the classic hybris-watch settings.
require conf/machine/include/hybris-watch.inc

# meta-virtualization (LXC) is gated on DISTRO_FEATURES=virtualization.
# Pre-GKI watches don't need LXC, so the feature is set here, not distro-wide.
DISTRO_FEATURES:append = " virtualization"

# The Android side runs as a Halium LXC container, so drop meta-asteroid's
# `android-init` and meta-android's `android-system` (both added by
# hybris-watch.inc) -- the per-device layer ships its own LXC bundle instead.
IMAGE_INSTALL:remove = "android-init android-system"

# GKI kernels must be built with clang, which pulls in meta-clang. meta-clang's
# clang-native and oe-core's llvm-native both install the full LLVM toolchain
# (binaries + headers + libs) and clash in -native recipe sysroots. The
# meta-clang README recommends making clang-native PROVIDE llvm-native and
# preferring it as the provider, so one recipe satisfies both names and
# oe-core's llvm_*.bb never builds.
PROVIDES:append:pn-clang-native = " llvm-native"
PREFERRED_PROVIDER_llvm-native = "clang-native"
```

## conf/machine/include/hybris-watch.inc
```bitbake
MACHINE_FEATURES = "alsa bluetooth usbgadget usbhost ext2"

SERIAL_CONSOLE = "115200 ttyHSL0"

PREFERRED_PROVIDER_virtual/mesa = "libhybris"
PREFERRED_PROVIDER_virtual/egl = "libhybris"
PREFERRED_PROVIDER_virtual/libgles1 = "libhybris"
PREFERRED_PROVIDER_virtual/libgles2 = "libhybris"

PREFERRED_PROVIDER_virtual/android-headers = "android"
PREFERRED_PROVIDER_virtual/android-system-image = "android"

KERNEL_IMAGETYPE = "zImage-dtb"
IMAGE_FSTYPES += "ext4"
IMAGE_ROOTFS_ALIGNMENT="4"

IMAGE_INSTALL += "android-tools android-system firmwared"

DEFAULTTUNE = "armv7vehf-neon"
```
